## Kconfig
```kconfig
menuconfig PAW3222
	bool "PAW3222 mouse optical sensor"
	select SPI
	help
	  Enable PAW3222 mouse optical sensor.

if PAW3222

config PAW3222_CPI
	int "Default CPI resolution"
	default 800
	range 200 3200
	help
	  Default CPI resolution for the PAW3222 sensor.

config PAW3222_SNIPE_CPI
	int "Snipe mode CPI resolution"
	default 400
	range 200 3200
	help
	  CPI resolution for snipe mode (precise movement).

config PAW3222_CPI_DIVIDOR
	int "Movement divider for normal mode"
	default 1
	range 1 10
	help
	  Movement divider for normal mode. Higher values reduce sensitivity.

config PAW3222_SNIPE_CPI_DIVIDOR
	int "Movement divider for snipe mode"
	default 1
	range 1 10
	help
	  Movement divider for snipe mode. Higher values reduce sensitivity.

config PAW3222_SCROLL_TICK
	int "Scroll tick threshold"
	default 20
	range 5 100
	help
	  Movement threshold for generating scroll events. Higher values require
	  more movement to trigger a scroll event.

config PAW3222_AUTOMOUSE_TIMEOUT_MS
	int "Automouse layer timeout in milliseconds"
	default 600
	range 100 5000
	help
	  Timeout in milliseconds for deactivating the automouse layer after
	  the last mouse movement.

endif # PAW3222
```

## dts/bindings/pixart,paw3222.yaml
```yaml
# Copyright 2024 Google LLC
# Copyright 2025 sekigon-gonnoc
# SPDX-License-Identifier: Apache-2.0

description: PAW32xx ultra low power wireless mouse chip

compatible: "pixart,paw3222"

include: spi-device.yaml

properties:
  irq-gpios:
    type: phandle-array
    required: true
    description:
      GPIO connected to the motion pin, active low.

  power-gpios:
    type: phandle-array
    required: false
    description:
      GPIO connected to the power control pin.

  res-cpi:
    type: int
    description: |
      CPI resolution for the sensor. This can also be changed in runtime using
      the paw32xx_set_resolution() API.

  force-awake:
    type: boolean
    description: |
      Initialize the sensor in "force awake" mode. This can also be enabled or
      disabled in runtime by the application using the paw32xx_force_awake()
      API.

  scroll-layers:
    type: array
    description: |
      List of layer numbers where the sensor should operate in scroll mode.
      When any of these layers are active, the sensor will report scroll
      wheel events instead of mouse movement.

  snipe-layers:
    type: array
    description: |
      List of layer numbers where the sensor should operate in snipe mode.
      When any of these layers are active, the sensor will use reduced
      sensitivity for precise movement.

  snipe-cpi:
    type: int
    description: |
      CPI resolution for snipe mode. Lower values provide more precise movement.

  cpi-dividor:
    type: int
    default: 1
    description: |
      Movement divider for normal mode. Higher values reduce sensitivity.

  snipe-cpi-dividor:
    type: int
    default: 1
    description: |
      Movement divider for snipe mode. Higher values reduce sensitivity.

  scroll-tick:
    type: int
    default: 20
    description: |
      Movement threshold for generating scroll events. Higher values require
      more movement to trigger a scroll event.

  automouse-layer:
    type: int
    description: |
      Layer number to automatically activate when mouse movement is detected.
      Set to 0 to disable automouse functionality.

  automouse-timeout-ms:
    type: int
    default: 600
    description: |
      Timeout in milliseconds for deactivating the automouse layer after
      the last mouse movement.
```
